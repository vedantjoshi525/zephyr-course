## CMakeLists.txt
```
cmake_minimum_required(VERSION 3.20.0)

find_package(Zephyr REQUIRED)
project(my_zephyr_app)

target_sources(app PRIVATE src/main.cpp)
```

## Kconfig
```
menu "Application"

config APP_HEARTBEAT_PERIOD_MS
	int "Heartbeat period in milliseconds"
	default 500
	range 100 2000
	help
	  Heartbeat LED blink period in milliseconds.

endmenu

menu "LED Subsystem"

config LED_SUBSYSTEM
    bool "LED Subsystem"
    default y
    help
      Enable the LED subsystem.

if LED_SUBSYSTEM

choice
    prompt "LED blink sleep time"
    default BLINK_SLEEP_1000MS

config BLINK_SLEEP_250MS
    bool "250 ms (fast)"

config BLINK_SLEEP_500MS
    bool "500 ms (medium)"

config BLINK_SLEEP_1000MS
    bool "1s (medium)"

config BLINK_SLEEP_2000MS
    bool "2s (slow)"

endchoice

config BLINK_SLEEP_TIME_MS
    int
    default 250 if BLINK_SLEEP_250MS
    default 500 if BLINK_SLEEP_500MS
    default 1000 if BLINK_SLEEP_1000MS
    default 2000 if BLINK_SLEEP_2000MS
    default 1000
    help
        Internal blink sleep time in milliseconds.

menuconfig LED_ADVANCED_SETTINGS
    bool "Advanced LED settings"
    default n
    help
        Enable advanced LED settings.

if LED_ADVANCED_SETTINGS

config LED_BRIGHTNESS
    int "LED brightness (0-100)"
    default 100
    range 0 100
    help
        Set LED brightness level from 0 to 100.

config LED_FADE_DURATION
    int "LED fade duration (ms)"
    default 500
    range 0 5000
    help
        Duration of LED fade effect in milliseconds.

menu "Expert settings"

config LED_DEBUGGING
    bool "Enable LED debugging"
    default n
    help
        Enable debug logging for the LED subsystem.

config LED_CUSTOM_BLINK_PATTERN
    bool "Custom blink pattern"
    default n
    help
        Enable a custom blink pattern for the LED.

endmenu #Expert settings
endif #LED_ADVANCED_SETTINGS
endif #LED_SUBSYSTEM
endmenu #LED Subsystem

source "Kconfig.zephyr"
```

## prj.conf
```kconfig
CONFIG_GPIO=y
CONFIG_LOG=y
#CONFIG_BLINK_SLEEP_500MS=y
```

## app.overlay
```dts
/ {
	aliases {
		app-led = &green_led_1;
	};
};
```

## src/main.cpp
```c
#include <zephyr/kernel.h>
#include <zephyr/device.h>
#include <zephyr/drivers/gpio.h>
#include <zephyr/devicetree.h>
#include <zephyr/logging/log.h>
LOG_MODULE_REGISTER(main, LOG_LEVEL_INF);

#define APP_LED_NODE DT_ALIAS(app_led)
#define STATUS_LED_NODE DT_ALIAS(status_led)
#define POWER_LED_NODE  DT_ALIAS(power_led)

static const struct gpio_dt_spec led_0 = GPIO_DT_SPEC_GET(APP_LED_NODE, gpios);
static const struct gpio_dt_spec led_1 = GPIO_DT_SPEC_GET(STATUS_LED_NODE, gpios);
static const struct gpio_dt_spec led_2 = GPIO_DT_SPEC_GET(POWER_LED_NODE, gpios);

int main(void)
{
    bool led_state = true;

    if (!gpio_is_ready_dt(&led_0)) return 0;
    if (!gpio_is_ready_dt(&led_1)) return 0;
    if (!gpio_is_ready_dt(&led_2)) return 0;

    if (gpio_pin_configure_dt(&led_0, GPIO_OUTPUT_ACTIVE) < 0) return 0;
    if (gpio_pin_configure_dt(&led_1, GPIO_OUTPUT_ACTIVE) < 0) return 0;
    if (gpio_pin_configure_dt(&led_2, GPIO_OUTPUT_ACTIVE) < 0) return 0;

    while (1) {
        if (gpio_pin_toggle_dt(&led_0) < 0) return 0;
        if (gpio_pin_toggle_dt(&led_1) < 0) return 0;
        if (gpio_pin_toggle_dt(&led_2) < 0) return 0;


        led_state = !led_state;
        LOG_INF("LED state: %s", led_state ? "ON" : "OFF");
        k_msleep(CONFIG_BLINK_SLEEP_TIME_MS);
    }

    return 0;
}
```
