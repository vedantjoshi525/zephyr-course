## app/03_stm32_f429zi/Kconfig
```kconfig
source "Kconfig.zephyr"

menu "My app config"

config APP_HEARTBEAT_PERIOD_MS
	int "Heartbeat period in ms"
	default 500
	range 100 2000

endmenu
```

## app/03_stm32_f429zi/boards/my_board/Kconfig.defconfig
```kconfig
# NUCLEO-144 F429ZI board configuration

# Copyright (c) 2017 Linaro Limited
# SPDX-License-Identifier: Apache-2.0

if BOARD_MY_BOARD

if NETWORKING

config NET_L2_ETHERNET
	default y

endif # NETWORKING

endif # BOARD_MY_BOARD
```

## app/03_stm32_f429zi/boards/my_board/board.yml
```yaml
board:
  name: my_board
  full_name: My Board
  vendor: vedant
  socs:
    - name: stm32f429xx
```

## app/03_stm32_f429zi/boards/my_board_stm32/board.yml
```yaml
board:
  name: my_board_stm32
  full_name: My Board STM32
  vendor: vedant
  socs:
    - name: stm32f429xx
```
